## Kconfig
```kconfig
# ZDT CAN 驱动配置
menu "libzdt Configuration"

config ZDT_ENABLE_TWAI_DRIVER
    bool "Enable ESP-IDF TWAI Driver"
    default y
    help
        启用 ESP-IDF TWAI 驱动实现作为 CAN 驱动后端。
        如果禁用，需要提供自定义的 CAN 驱动实现。

endmenu
```

## test/sdkconfig.defaults
```kconfig
# ESP-IDF 配置文件默认值
# libzdt 测试项目

# 启用 TWAI 驱动
CONFIG_ZDT_ENABLE_TWAI_DRIVER=y

# 日志配置
CONFIG_LOG_DEFAULT_LEVEL_INFO=y
CONFIG_LOG_COLORS=y

# FreeRTOS 配置
CONFIG_FREERTOS_HZ=1000

# 主循环任务栈大小
CONFIG_ESP_MAIN_TASK_STACK_SIZE=4096
```

## test_espidf/main/Kconfig.projbuild
```kconfig
menu "ZDT Test Configuration"

    config ZDT_TEST_HARDWARE
        bool "Enable hardware tests (requires CAN transceiver and motor)"
        default n
        help
            启用此选项以运行需要实际硬件的测试。
            需要连接CAN收发器和ZDT电机。

    config ZDT_TEST_CAN_TX_GPIO
        int "CAN TX GPIO"
        default 21
        depends on ZDT_TEST_HARDWARE
        help
            CAN发送引脚

    config ZDT_TEST_CAN_RX_GPIO
        int "CAN RX GPIO"
        default 22
        depends on ZDT_TEST_HARDWARE
        help
            CAN接收引脚

    config ZDT_TEST_MOTOR_ADDR
        int "Motor address for testing"
        default 1
        range 1 255
        depends on ZDT_TEST_HARDWARE
        help
            用于测试的电机地址

endmenu
```
